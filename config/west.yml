## config/west.yml
```yaml
manifest:
  remotes:
    - name: zmkfirmware
      url-base: https://github.com/zmkfirmware
    - name: ssbb
      url-base: https://github.com/ssbb
    - name: joelspadin
      url-base: https://github.com/joelspadin
    - name: crazy-keyboards
      url-base: https://github.com/crazy-keyboards

  projects:
    - name: zmk
      import: app/west.yml
      remote: zmkfirmware
      revision: main
    - name: zmk-listeners
      remote: ssbb
      revision: v1
    - name: zmk-locales
      remote: crazy-keyboards
      revision: develop
    - name: zmk-helpers
      remote: crazy-keyboards
      revision: develop
    - name: zmk-nice-oled
      remote: crazy-keyboards
      revision: main

  self:
    path: config
```
