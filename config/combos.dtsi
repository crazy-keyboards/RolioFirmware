/*                  KEY POSITIONS
 ╭─────────────────────────┬─────────────────────────╮
 │ LT5 LT4 LT3 LT2 LT1 LT0 │ RT0 RT1 RT2 RT3 RT4 RT5 │
 │ LM5 LM4 LM3 LM2 LM1 LM0 │ RM0 RM1 RM2 RM3 RM4 RM5 │
 │ LB5 LB4 LB3 LB2 LB1 LB0 │ RB0 RB1 RB2 RB3 RB4 RB5 │
 ╰───╮ LH4 LH3 LH2 LH1 LH0 │ RH0 RH1 RH2 RH3 RH4 ╭───╯
     ╰─────────────────────┴─────────────────────╯     */

#include "layers.dtsi"

#define COMBO_TERM_FAST 18
#define COMBO_TERM_SLOW 30

#define COMBO_IDLE_FAST 150
#define COMBO_IDLE_SLOW 50

ZMK_COMBO(esc,
    &kp ESC,
    LT5 LT4,
    ENG RUS MATHS)

ZMK_COMBO(settings,
    &tog KB_CONFIG,
    LT5 LT0,
    ENG RUS KB_CONFIG)

ZMK_COMBO(ZX_ctrlC,
    &kp LC(Z),
    LB4 LB3,
    ENG RUS)

ZMK_COMBO(XC_ctrlX,
    &kp LC(X),
    LB3 LB2,
    ENG RUS    
)

ZMK_COMBO(CV_ctrlC,
    &kp LC(C),
    LB2 LB1,
    ENG RUS
)

ZMK_COMBO(VB_ctrlV,
    &kp LC(V),
    LB1 LB0,
    ENG RUS
)

ZMK_COMBO(sk_win_left,
    &sk LGUI,
    LH4 LH3,
    ALL
)

ZMK_COMBO(sk_alt_left,
    &sk LALT,
    LH3 LH2,
    ALL
)

ZMK_COMBO(sk_ctrl_left,
    &sk LCTL,
    LH2 LH1,
    ALL
)

ZMK_COMBO(sk_shift_left,
    &sk LSHFT,
    LH1 LH0,
    ALL
)

ZMK_COMBO(cm_lpar),
    &kp LPAR,
    LT1 LM1,
    ENG RUS
)

ZMK_COMBO(cm_rpar),
    &kp RPAR,
    RT1 RM1,
    ENG RUS
)

ZMK_COMBO(cm_lbkt),
    &kp LBKT,
    LT2 LM2,
    ENG RUS
)

ZMK_COMBO(cm_rbkt),
    &kp RBKT,
    RT2 RM2,
    ENG RUS
)

ZMK_COMBO(cm_lbrc),
    &kp LBRC,
    LT3 LM3,
    ENG RUS
)

ZMK_COMBO(cm_rbrc),
    &kp RBRC,
    RT3 RM3,
    ENG RUS
)